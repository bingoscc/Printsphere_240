## main/Kconfig.projbuild
```kconfig
menu "PrintSphere Configuration"

    config PRINTSPHERE_DEVICE_NAME
        string "Device Name"
        default "PrintSphere"
        help
            Name of the device for HASS discovery

    config PRINTSPHERE_WIFI_AP_SSID
        string "Setup AP SSID"
        default "PrintSphere-Setup"
        help
            SSID for setup access point

    config PRINTSPHERE_BAMBU_CLOUD_ENABLED
        bool "Enable Bambu Cloud"
        default y
        help
            Enable Bambu Cloud MQTT connection

    config PRINTSPHERE_HASS_ENABLED
        bool "Enable HomeAssistant MQTT"
        default y
        help
            Enable HomeAssistant MQTT integration

    config PRINTSPHERE_POLL_INTERVAL_MS
        int "Printer Poll Interval (ms)"
        default 3000
        help
            Interval for polling printer status

endmenu
```

## sdkconfig.defaults
```kconfig
# ESP-IDF Configuration
CONFIG_ESPTOOLPY_FLASHMODE_QIO=y
CONFIG_ESPTOOLPY_FLASHFREQ_80M=y
CONFIG_ESPTOOLPY_FLASHSIZE_8MB=y
CONFIG_PARTITION_TABLE_CUSTOM=y

# FreeRTOS
CONFIG_FREERTOS_HZ=1000

# WiFi
CONFIG_ESP32_WIFI_STATIC_TX_BUFFER=n
CONFIG_ESP32_WIFI_DYNAMIC_TX_BUFFER=y
CONFIG_ESP32_WIFI_AMPDU_TX_ENABLED=n
CONFIG_ESP32_WIFI_AMPDU_RX_ENABLED=n

# LVGL
CONFIG_LVGL_MEM_SUPERFAST=y
CONFIG_LVGL_THREAD_SAFE=y

# MQTT
CONFIG_MQTT_TRANSPORT_WEBSOCKET=y
CONFIG_MQTT_USE_CUSTOM_CONFIG=y

# NVS
CONFIG_NVS_ENCRYPTION=y

# SDMMC
CONFIG_SDMMC_MODE_ENABLED=y
CONFIG_SDMMC_FREQ_40M=y
CONFIG_SDMMC_BUS_WIDTH_4=y
```
